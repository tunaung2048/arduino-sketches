// Dot Matrix Display

char anodePins[8] = { 2, 3, 4, 5, 6, 7, 8, 9 };
char cathodePins[8] = { 10, 11, 12, 13, A0, A1, A2, A3}; // { 10, 11, 12, 13, 14, 15, 16, 17};

byte image[8][8] = {
  {1,1,1,1,1,1,1,1},
  {1,1,1,1,1,1,1,1},
  {1,1,1,1,1,1,1,1},
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  {1,1,1,1,1,1,1,1},
};
byte image0[8][8] = {
// 1  2  3  4  5  6  7  8
  {1, 1, 1, 1, 1, 1, 1, 1},
  {1, 1, 1, 1, 1, 1, 1, 1},
  {1, 1, 0, 1, 1, 0, 1, 1},
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  {1, 1, 1, 1, 1, 1, 1, 1}
};
byte image2[8][8] = {
// 1 2 3 4 5 6 7 8
  {0,0,0,1,0,0,0,0},
  {0,0,0,1,0,0,0,0},
  {0,0,0,1,0,0,1,0},
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  {1,1,1,1,1,1,1,1}
};
byte image3[8][8] = {
  
};

void setup() {
  for (int pin=2; pin<=17; pin++)
    pinMode(pin, OUTPUT);

}

void loop() {
  for (int k=0; k<8; k++) {
    for(int j=0; j<8; j++) {
      digitalWrite(cathodePins[j], LOW);
      digitalWrite(cathodePins[k], HIGH);
      for (int a=0; a<8; a++) {
        digitalWrite(anodePins[a], LOW);
      }
      for (int a=0; a<8; a++) {
        digitalWrite(anodePins[a], image[a][k]);
        
      }
      
    }
  //delay(300);  
  }
  
}
